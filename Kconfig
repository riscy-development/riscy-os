## Kconfig
```kconfig
#mainmenu "RISCy OS Configuration"

source "arch/Kconfig"


menu "Build Options"

config OPTIMIZATION_LEVEL
	int "Optimization level (-O)"
	default 0
	range 0 3
	help
          Can obviously improve performance. However, may expose bugs. Not
	  recommended for general development (this isn't Nautilus).

config DEBUG_SYMBOLS
	bool "Generate debug symbols (-g)"
	default y if OPTIMIZATION_LEVEL = 0
	default n # otherwise
	help
          This can be useful when debugging with attached GDB in QEMU. Leads to
          code bloat though. Enabled by default at "-O0", must be enabled manually
          otherwise.

config ADDITIONAL_KERNEL_FLAGS
	string "Additional flags to pass to GCC"
	default ""
	help
          This simply gets tacked on to the end of CFLAGS.

endmenu
```

## arch/Kconfig
```kconfig
# The root architecture configuration
choice
	prompt "Architecture"
	default RISCV64

	config RISCV32
		bool "RISC-V (32-bit)"

	config RISCV64
		bool "RISC-V (64-bit)"

	# config X86
	# 	bool "x86"

	# config X86_64
	# 	bool "x86_64"

	config ARM64
	 	bool "ARM64"
endchoice


# menu "x86_64 Configuration"
# 	depends on X86_64
# 	source "arch/x86_64/Kconfig"
# endmenu


menu "RISC-V Configuration"
	depends on RISCV32 || RISCV64
	source "arch/riscv/Kconfig"
endmenu


menu "ARM64 Configuration"
	depends on ARM64
	source "arch/arm64/Kconfig"
endmenu

choice
	prompt "Endianness"
	default VARIABLE_ENDIAN

	config LITTLE_ENDIAN
		bool "Little Endian"
	config BIG_ENDIAN
		bool "Big Endian"
	config VARIABLE_ENDIAN
		bool "Variable Endian"
endchoice

###############################################################################
# Computed options
###############################################################################
config RISCV
	bool
	default y if RISCV32 || RISCV64
	default n  # otherwise

config 64_BIT
	bool
	default y if X86_64 || RISCV64 || ARM64
	default n

config KERNEL_VIRTUAL_BASE
	hex
	default 0xffff880000000000 if X86 || X86_64

	# RISC-V
	default 0x80000000 if SV32 && RISCV
	default 0xffffffc000000000 if SV39 && RISCV
	default 0xffff800000000000 if SV48 && RISCV

	# ARM64
	default 0xffffffff80000000 if ARM64

config ARCH_NAME
	string
	default "riscv64" if RISCV
	default "x86_64" if X86_64
	default "i386" if X86
	default "aarch64" if ARM64

config ARCH_DIR
	string
	default "x86" if X86
	default "x86_64" if X86_64
	default "riscv" if RISCV
	default "arm64" if ARM64
```

## arch/arm64/Kconfig
```kconfig
choice
	prompt "Generic Interrupt Controller (GIC) Version"
	default GICV2

	config GICV2
		bool "GICv2"

	config GICV3
		bool "GICv3"
endchoice
```

## arch/riscv/Kconfig
```kconfig
choice
	prompt "Virtual memory system"
	default SV39

	config SV32
		bool "Sv32 - 32-bit paging"
		select VARIABLE_ENDIAN
		depends on RISCV32

	config SV39
		bool "Sv39 - 39-bit paging"
		select VARIABLE_ENDIAN
		depends on RISCV64

	config SV48
		bool "Sv48 - 48-bit paging"
		select VARIABLE_ENDIAN
		depends on RISCV64
endchoice
```
